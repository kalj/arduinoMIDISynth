const unsigned long freqIncTab[] = {796254, 843601, 893765, 946911, 1003217, 1062871, 1126073, 1193033, 1263974, 1339134, 1418763, 1503127, 1592507,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 1153098554, 1221665363};
const unsigned char compressTab[] = {1, 1, 1, 1, 1, 1, 1, 1, 1, 1, 1, 1, 1,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 255, 255};

class Note
{
  public:
  unsigned char n;
  char state;
  unsigned long phase;
  unsigned long freqInc;
  short velocity;

  Note()
  {
    state = -1;
  }

  void on(unsigned char n, unsigned char v)
  {
    state = -1;
    this->n = n;
    velocity = v;
    phase = 0;
    freqInc = freqIncTab[n];
    state = 0;
  }

  void off()
  {
    state = -1;
  }

  short mix()
  {
    short s = 0;
    s = (phase >> 24) - 128;
    s = ((s * velocity) >> 7);
    phase += freqInc;
    return s;
  }
};

char noteMap[16][128];
#define MAX_NOTES 16
Note notes[MAX_NOTES];

void noteOff(byte ch, byte n, byte v)
{
  if(noteMap[ch][n] >= 0)
  {
    notes[noteMap[ch][n]].off();
    noteMap[ch][n] = -1;
  }
}

void noteOn(byte ch, byte n, byte v)
{
  if(!v)
  {
    noteOff(ch, n, 0);
    return;
  }
  else
    if(noteMap[ch][n] >= 0)
      notes[noteMap[ch][n]].on(n, v);
    else
      for(char i = 0; i < MAX_NOTES; i++)
        if(notes[i].state == -1)
        {
          noteMap[ch][n] = i;
          notes[i].on(n, v);
          break;
        }
}

void setup()
{
  Serial1.begin(31250);

  DDRC = 255;

  TCCR5B = (1 << WGM52) | (1 << CS50); //clear timer on compare (CTC), no prescaling, reset timer after <OCR5A> cycles
  OCR5A = 16000000L / 44100;
  TIMSK5 = (1 << OCIE5A); //enable interrupt on

  for(char j = 0; j < 16; j++)
    for(char i = 0; i < 127; i++)
      noteMap[j][i] = -1;
}

ISR(TIMER5_COMPA_vect)
{
  short s = 0;
  for(unsigned char i = 0; i < MAX_NOTES; i++)
    if(notes[i].state >= 0)
    {
      s += notes[i].mix();
    }

  PORTC = compressTab[s + 2048];
}

unsigned char count;
unsigned char command[2];
void loop()
{
  while(Serial1.available())
  {
    unsigned char a = Serial1.read();
    if(a > 127)
      count = 0;
    else
    {
      if(count == 2)
      {
        if((command[0] & 0xf0) == 0x90)
          noteOn(command[0] & 0xf, command[1], a);
        if((command[0] & 0xf0) == 0x80)
          noteOff(command[0] & 0xf, command[1], a);
        }
    }
    if(count < 2)
      command[count] = a;
    count++;
  }
}
